/*
 * display_min -- minimal ST7789 driver for bare IDF apps on the
 * LilyGO T-Deck (loader GUI + iq lab status).
 *
 * 320x240 landscape (MADCTL 0x60), RGB565, inversion on -- matching
 * the vtOS st7789 module's init for the same panel so colors and
 * orientation agree across boot slots.
 *
 * Pins: SPI2 (FSPI) SCK=40 MOSI=41 MISO=38, TFT_CS=12 (manual GPIO),
 * TFT_DC=11, backlight=42. The bus is the shared T-Deck SPI bus; only
 * this driver talks to it while the loader runs.
 *
 * Copyright (c) 2026 8bitmcu
 * License: MIT (font table public domain -- see below)
 */

#include "display_min.h"

#include "driver/gpio.h"
#include "driver/spi_master.h"
#include "esp_check.h"
#include "esp_log.h"
#include "esp_rom_sys.h"
#include "soc/gpio_num.h"

static spi_device_handle_t s_spi;
static bool s_ready;

/* font table -- font8x8_basic, codepoints 32..127 -- public domain,
 * Daniel Hepper / Marcel Sondaar / IBM VGA font8x8 */
static const uint8_t FONT8X8[96][8] = {
    {0x00, 0x00, 0x00, 0x00, 0x00, 0x00, 0x00, 0x00}, /* 32 */
    {0x18, 0x3C, 0x3C, 0x18, 0x18, 0x00, 0x18, 0x00}, /* 33 */
    {0x36, 0x36, 0x00, 0x00, 0x00, 0x00, 0x00, 0x00}, /* 34 */
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    {0x00, 0x00, 0x00, 0x00, 0x00, 0x00, 0x00, 0x00}, /* 127 */
};

#define PIN_SCK  40
#define PIN_MOSI 41
#define PIN_MISO 38
#define PIN_CS   12
#define PIN_DC   11
#define PIN_BL   42
#define PIN_POWERON 10 /* T-Deck: gates 3V3 to display/keyboard/radio */
#define PIN_SD_CS   39 /* other devices on the shared SPI bus: keep deselected */
#define PIN_LORA_CS 9

/* ST7789 commands */
#define CMD_SWRESET 0x01
#define CMD_SLPOUT  0x11
#define CMD_NORON   0x13
#define CMD_INVOFF  0x20
#define CMD_INVON   0x21
#define CMD_DISPON  0x29
#define CMD_CASET   0x2A
#define CMD_RASET   0x2B
#define CMD_RAMWR   0x2C
#define CMD_MADCTL  0x36
#define CMD_COLMOD  0x3A

static void dc_cmd(void)
{
    gpio_set_level(PIN_DC, 0);
}

static void dc_data(void)
{
    gpio_set_level(PIN_DC, 1);
}

static void spi_send(const uint8_t *data, size_t len)
{
    if (len == 0) {
        return;
    }
    esp_err_t err;
    if (len == 1) {
        spi_transaction_t t = {
            .flags = SPI_TRANS_USE_TXDATA,
            .length = 8,
            .tx_data = {data[0]},
        };
        err = spi_device_transmit(s_spi, &t);
    } else {
        spi_transaction_t t = {
            .tx_buffer = data,
            .length = len * 8,
        };
        err = spi_device_transmit(s_spi, &t);
    }
    if (err != ESP_OK) {
        ESP_LOGE("display", "spi %d", err);
    }
}

static void write_cmd(uint8_t cmd, const uint8_t *data, size_t len)
{
    gpio_set_level(PIN_CS, 0);
    dc_cmd();
    uint8_t c = cmd;
    spi_send(&c, 1);
    if (data && len) {
        dc_data();
        spi_send(data, len);
    }
    gpio_set_level(PIN_CS, 1);
}

esp_err_t display_init(void)
{
    if (s_ready) {
        return ESP_OK;
    }

    gpio_config_t io = {
        .pin_bit_mask = (1ULL << PIN_CS) | (1ULL << PIN_DC) | (1ULL << PIN_BL),
        .mode = GPIO_MODE_OUTPUT,
        .pull_up_en = GPIO_PULLUP_DISABLE,
        .pull_down_en = GPIO_PULLDOWN_DISABLE,
        .intr_type = GPIO_INTR_DISABLE,
    };
    gpio_config(&io);

    /* Without GPIO10 high the panel is unpowered (blank screen). */
    gpio_config_t aux = {
        .pin_bit_mask = (1ULL << PIN_POWERON) | (1ULL << PIN_SD_CS) | (1ULL << PIN_LORA_CS),
        .mode = GPIO_MODE_OUTPUT,
        .pull_up_en = GPIO_PULLUP_DISABLE,
        .pull_down_en = GPIO_PULLDOWN_DISABLE,
        .intr_type = GPIO_INTR_DISABLE,
    };
    gpio_config(&aux);
    gpio_set_level(PIN_POWERON, 1);
    gpio_set_level(PIN_SD_CS, 1);
    gpio_set_level(PIN_LORA_CS, 1);
    esp_rom_delay_us(100 * 1000); /* let the rail settle */

    gpio_set_level(PIN_CS, 1);
    gpio_set_level(PIN_DC, 0);
    gpio_set_level(PIN_BL, 0);

    spi_bus_config_t bus = {
        .mosi_io_num = PIN_MOSI,
        .miso_io_num = PIN_MISO,
        .sclk_io_num = PIN_SCK,
        .quadwp_io_num = -1,
        .quadhd_io_num = -1,
    };
    spi_device_interface_config_t dev = {
        .clock_speed_hz = 40 * 1000 * 1000,
        .mode = 0,
        .spics_io_num = -1,   /* CS driven manually around DC toggles */
        .queue_size = 1,
    };
    esp_err_t err = spi_bus_initialize(SPI2_HOST, &bus, SPI_DMA_CH_AUTO);
    if (err != ESP_OK) {
        return err;
    }
    err = spi_bus_add_device(SPI2_HOST, &dev, &s_spi);
    if (err != ESP_OK) {
        return err;
    }

    write_cmd(CMD_SWRESET, NULL, 0);
    esp_rom_delay_us(150 * 1000);
    write_cmd(CMD_SLPOUT, NULL, 0);
    esp_rom_delay_us(120 * 1000);
    uint8_t colmod = 0x05;   /* 16-bit RGB565 */
    write_cmd(CMD_COLMOD, &colmod, 1);
    write_cmd(CMD_INVON, NULL, 0);
    uint8_t madctl = 0x60;   /* landscape 320x240, matches vtOS rotation=1 */
    write_cmd(CMD_MADCTL, &madctl, 1);
    write_cmd(CMD_NORON, NULL, 0);
    esp_rom_delay_us(10 * 1000);
    write_cmd(CMD_DISPON, NULL, 0);
    esp_rom_delay_us(150 * 1000);

    gpio_set_level(PIN_BL, 1);
    s_ready = true;
    return ESP_OK;
}

static void set_window(uint16_t x, uint16_t y, uint16_t w, uint16_t h)
{
    uint8_t caset[4] = {(uint8_t)(x >> 8), (uint8_t)x,
                        (uint8_t)((x + w - 1) >> 8), (uint8_t)(x + w - 1)};
    uint8_t raset[4] = {(uint8_t)(y >> 8), (uint8_t)y,
                        (uint8_t)((y + h - 1) >> 8), (uint8_t)(y + h - 1)};
    write_cmd(CMD_CASET, caset, 4);
    write_cmd(CMD_RASET, raset, 4);
    write_cmd(CMD_RAMWR, NULL, 0); /* pixel data that follows goes to GRAM */
}

void display_rect(uint16_t x, uint16_t y, uint16_t w, uint16_t h, uint16_t color)
{
    if (!s_ready) {
        return;
    }
    set_window(x, y, w, h);
    gpio_set_level(PIN_CS, 0);
    dc_data();
    static uint16_t row[DISPLAY_WIDTH];
    for (uint16_t i = 0; i < w; ++i) {
        row[i] = __builtin_bswap16(color); /* panel wants big-endian RGB565 */
    }
    for (uint16_t j = 0; j < h; ++j) {
        spi_send((const uint8_t *)row, (size_t)w * 2);
    }
    gpio_set_level(PIN_CS, 1);
}

void display_fill(uint16_t color)
{
    display_rect(0, 0, DISPLAY_WIDTH, DISPLAY_HEIGHT, color);
}

void display_text(uint16_t x, uint16_t y, const char *str,
                  uint16_t fg, uint16_t bg, uint8_t scale)
{
    if (!s_ready) {
        return;
    }
    if (scale == 0) {
        scale = 1;
    }
    /* one window + one row-stream per character keeps this fast enough
     * for the loader menu */
    static uint16_t rowbuf[8 * 4];
    uint16_t cx = x;
    for (const char *p = str; *p; ++p) {
        unsigned char ch = (unsigned char)*p;
        if (ch < 32 || ch > 127) {
            ch = '?';
        }
        const uint8_t *glyph = FONT8X8[ch - 32];
        uint16_t bw = (uint16_t)(8 * scale);
        set_window(cx, y, bw, (uint16_t)(8 * scale));
        gpio_set_level(PIN_CS, 0);
        dc_data();
        for (int r = 0; r < 8; ++r) {
            uint8_t bits = glyph[r];
            for (uint16_t k = 0; k < scale; ++k) {
                for (int c = 0; c < 8; ++c) {
                    uint16_t color = __builtin_bswap16((bits & (1 << c)) ? fg : bg);
                    for (uint16_t s = 0; s < scale; ++s) {
                        rowbuf[(uint16_t)c * scale + s] = color;
                    }
                }
                spi_send((const uint8_t *)rowbuf, (size_t)bw * 2);
            }
        }
        gpio_set_level(PIN_CS, 1);
        cx += bw;
        if (cx + bw > DISPLAY_WIDTH) {
            break;
        }
    }
}
